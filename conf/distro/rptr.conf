## conf/distro/rptr.conf
```bitbake
include conf/distro/poky.conf

DISTRO = "rptr"
DISTRO_NAME = "rptr"

INIT_MANAGER = "systemd"

DISTRO_FEATURES = "argp ext2 ipv4 ipv6"

RPI_USE_U_BOOT = "1"

IMAGE_FSTYPES:append = " ext4 ext4.gz"
```

## conf/layer.conf
```bitbake
# We have a conf and classes directory, add to BBPATH
BBPATH .= ":${LAYERDIR}"

# We have recipes-* directories, add to BBFILES
BBFILES += "${LAYERDIR}/recipes-*/*/*.bb \
	    ${LAYERDIR}/recipes-*/*/*.bbappend"

BBFILE_COLLECTIONS += "meta-rptr"
BBFILE_PATTERN_meta-rptr = "^${LAYERDIR}/"
BBFILE_PRIORITY_meta-rptr = "6"

LAYERDEPENDS_rptr = "core poky yocto-bsp oe python networking raspberrypi swupdate"
LAYERSERIES_COMPAT_meta-rptr = "nanbield"

WKS_FILE = "rptr.wks"
```
